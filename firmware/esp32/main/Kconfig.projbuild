## firmware/esp32/main/Kconfig.projbuild
```kconfig
menu "FeatherShield Configuration"
config FEATHERSHIELD_DEBUG_MODE
    bool "Enable Debug Mode"
    default n
    help
        Enable debug mode with hardcoded WiFi credentials.

config FEATHERSHIELD_WIFI_SSID
    string "WiFi SSID for Debug Mode"
    depends on FEATHERSHIELD_DEBUG_MODE
    default "FeatherShield_Debug"
    help
        SSID of the WiFi network to connect to in debug mode.

config FEATHERSHIELD_WIFI_PASSWORD
    string "WiFi Password for Debug Mode"
    depends on FEATHERSHIELD_DEBUG_MODE
    default "feathershield"
    help
        Password of the WiFi network to connect to in debug mode.

config FEATHERSHIELD_BROKER_URL
    string "Broker URL"
    default ""
    help
        URL of the MQTT broker.
        
config CAMERA_MODEL
    string "Camera Model"
    default ""
    help
        Camera model to use.
endmenu
```

## firmware/esp32/sdkconfig.defaults
```kconfig
# Default sdkconfig for FeatherShield ESP32 project
CONFIG_BT_ENABLED=y
CONFIG_BT_NIMBLE_ENABLED=y

CONFIG_PARTITION_TABLE_CUSTOM=y
CONFIG_ESPTOOLPY_FLASHSIZE_4MB=y

CONFIG_ESP32S3_SPIRAM_SUPPORT=y
CONFIG_SOC_PSRAM_DMA_CAPABLE=y
CONFIG_SPIRAM=y
CONFIG_SPIRAM_MODE_OCT=y
CONFIG_SPIRAM_TYPE_AUTO=y
CONFIG_SPIRAM_CLK_IO=30
CONFIG_SPIRAM_CS_IO=26

CONFIG_PM_ENABLE=y
CONFIG_FREERTOS_USE_TICKLESS_IDLE=y
CONFIG_FREERTOS_IDLE_TIME_BEFORE_SLEEP=3
```
